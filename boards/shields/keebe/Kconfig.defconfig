## boards/shields/keebe/Kconfig.defconfig
```kconfig
if SHIELD_KEEBE_LEFT

config ZMK_KEYBOARD_NAME
    default "keebe"

config ZMK_SPLIT_ROLE_CENTRAL
    default y

# bluetooth stuff 

config ZMK_SPLIT_BLE_CENTRAL_PERIPHERALS
    default 1

config BT_MAX_CONN
    default 6

config BT_MAX_PAIRED
    default 6

# end bluetooth stuff 

endif # SHIELD_KEEBE_LEFT

if SHIELD_KEEBE_LEFT || SHIELD_KEEBE_RIGHT

config ZMK_SPLIT
    default y

endif # SHIELD_KEEBE_LEFT || SHIELD_KEEBE_RIGHT
```

## boards/shields/keebe/Kconfig.shield
```kconfig
config SHIELD_KEEBE_LEFT
    def_bool $(shields_list_contains,keebe_left)

config SHIELD_KEEBE_RIGHT
    def_bool $(shields_list_contains,keebe_right)
```
